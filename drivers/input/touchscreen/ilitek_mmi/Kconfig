## drivers/input/touchscreen/ilitek_mmi/Kconfig
```kconfig
#
# Ipio Touchscreen driver configuration
#

config TOUCHSCREEN_ILI9881H
    tristate "Ipio ILI9881H Touchscreen"
    depends on I2C
    default n
    help
    Say Y here if you have Ilitek touch panel.
    If unsure, say N.
```
